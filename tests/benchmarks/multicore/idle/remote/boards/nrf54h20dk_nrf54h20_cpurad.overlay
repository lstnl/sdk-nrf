/*
 * Copyright (c) 2025 Nordic Semiconductor ASA
 *
 * SPDX-License-Identifier: LicenseRef-Nordic-5-Clause
 */

/ {
	aliases {
		watchdog0 = &cpurad_gswdt;
	};
};

&cpurad_gswdt {
	status = "okay";
};

&cpurad_cpusys_gswdt_mbox {
	status = "okay";
};
